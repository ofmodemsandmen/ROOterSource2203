/dts-v1/;

#include "mt7621_huasifei-ws1208v2.dtsi"

/ {
	compatible = "huasifei,huasifei-ws1208v2-32", "huasifei,huasifei-ws1208v2-32", "mediatek,mt7621-soc";
	model = "Huasifei-WS1208V2-32";
};

&firmware {
	reg = <0x50000 0x1fb0000>;
};

// SPDX-License-Identifier: BSD-3-Clause
/*
 *  Copyright(c) 2017 Kristian Evensen <kristian.evensen@gmail.com>.
 *  Copyright(c) 2017 Piotr Dymacz <pepe2k@gmail.com>.
 *  All rights reserved.
 */

#include "mt7621_mesh_m12k21.dtsi"

/ {
	compatible = "mesh,m12k21", "mesh,m12k21", "mediatek,mt7621-soc";
	model = "Mesh M12K21";
};

&firmware {
	reg = <0x50000 0xf90000>;
};